## board/bananapi/bananapi_m5/Kconfig
```kconfig
if TARGET_MESON_G12A

config SYS_CPU
	string
	default "armv8"

config SYS_BOARD
	string
	default "bananapi_m5"

config SYS_VENDOR
	string
	default "bananapi"

config SYS_SOC
	string
	default "g12a"

config SYS_CONFIG_NAME
	default "bananapi_m5"

endif
```
